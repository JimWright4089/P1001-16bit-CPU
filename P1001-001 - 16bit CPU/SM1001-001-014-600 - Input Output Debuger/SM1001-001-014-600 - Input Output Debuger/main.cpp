#ifndef F_CPU
#define F_CPU 8000000UL // 16 MHz clock speed
#endif



#include <avr/io.h>
#include <util/delay.h>

// 00110001
// 10001100
static const unsigned char BitReverseTable256[256] =
{
//0000  0001  0010  0011  0100  0101  0110  0111  1000  1001  1010  1011  1100  1101  1110  1111
//0000  1000  0100  1100  0010  1010  0110  1110  0001  1001  0101  1101  0011  1011  0111  1111  
  0x00, 0x80, 0x40, 0xc0, 0x20, 0xa0, 0x60, 0xe0, 0x10, 0x90, 0x50, 0xd0, 0x30, 0xb0, 0x70, 0xf0,
  0x08, 0x88, 0x48, 0xc8, 0x28, 0xa8, 0x68, 0xe8, 0x18, 0x98, 0x58, 0xd8, 0x38, 0xb8, 0x78, 0xf8,
  0x04, 0x84, 0x44, 0xc4, 0x24, 0xa4, 0x64, 0xe4, 0x14, 0x94, 0x54, 0xd4, 0x34, 0xb4, 0x74, 0xf4,
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  0x0f, 0x8f, 0x4f, 0xcf, 0x2f, 0xaf, 0x6f, 0xef, 0x1f, 0x9f, 0x5f, 0xdf, 0x3f, 0xbf, 0x7f, 0xff,
};

#define MYUBRR 25

unsigned char swap(unsigned char ch)
{
  char ch1 = (ch&0xf0)>>4;
  char ch2 = (ch&0x0f)<<4;
  return ch1+ch2;
  
}


void USART_Init( unsigned int baud )
{
  /* Set baud rate */
  UBRRH = (unsigned char)(baud>>8);
  UBRRL = (unsigned char)baud;
  /* Enable receiver and transmitter */
  UCSRB = (1<<RXEN)|(1<<TXEN);
  /* Set frame format: 8data, 2stop bit */
//  UCSRC = (1<<USBS)|(3<<UCSZ0);
}

void USART_Transmit( unsigned char data )
{
  /* Wait for empty transmit buffer */
  while ( !( UCSRA & (1<<UDRE)) )
  ;
  /* Put data into buffer, sends the data */
  UDR = data;
}

unsigned char USART_Receive( void )
{
  /* Wait for data to be received */
  while ( !(UCSRA & (1<<RXC)) )
  ;
  /* Get and return received data from buffer */
  return UDR;
}

int main()
{
  char ch1 = 0;
  char ch2 = 0;
  char ch3 = 0;
  
  DDRA = 0xFF;
  DDRC = 0xFF;
  
  PORTA = 0x00;
  PORTC = 0x00;

  USART_Init ( MYUBRR );
  while(1)
  {
    ch3 = ch2;
    ch2 = 0x55;
    ch1 = 0xCC;
//    ch1 = USART_Receive();
//    USART_Transmit(ch1);
    PORTC = ch1;
    //PORTA = ch2;
    //PORTA = BitReverseTable256[ch2];
    PORTA = swap(ch2);
  }
}


// --------------------------------------------------------------------
// Purpose:
//  The main loop
//
// Notes:
// None.
// --------------------------------------------------------------------
int mainx(void)
{
  DDRA = 0xFF;
  DDRC = 0xFF;
  char ch1 = 0;
  char ch2 = 0;
  
  while(1) //infinite loop
  {
    PORTA = ch1;
    PORTC = ch2;
    _delay_us(100000);
    ch1++;
    ch2--;
  }
}

